## boards/adi/adsp_sc83x/Kconfig.adsp_sc83x
```kconfig
#
# Copyright (C) 2023 Analog Devices, Inc
#
# SPDX-License-Identifier: Apache-2.0
#

config BOARD_ADSP_SC83X
	select SOC_ADSP_SC834 if BOARD_ADSP_SC83X_ADSP_SC834
	select SOC_ADSP_SC834W if BOARD_ADSP_SC83X_ADSP_SC834W
	select SOC_ADSP_SC835 if BOARD_ADSP_SC83X_ADSP_SC835
	select SOC_ADSP_SC835W if BOARD_ADSP_SC83X_ADSP_SC835W
```

## boards/adi/adsp_sc83x/Kconfig.defconfig
```kconfig
#
# Copyright (c) 2023 Analog Devices, Inc
#
# SPDX-License-Identifier: Apache-2.0
#

if SERIAL

config UART_INTERRUPT_DRIVEN
	default y

endif # SERIAL

if COVERAGE

config GEN_ISR_TABLES
	default y

config GEN_SW_ISR_TABLE
	default y

config MAIN_STACK_SIZE
	default 4096

config IDLE_STACK_SIZE
	default 4096

config PRIVILEGED_STACK_SIZE
	default 4096

config ISR_STACK_SIZE
	default 4096

config TEST_EXTRA_STACK_SIZE
	default 4096

endif # COVERAGE

config HAS_COVERAGE_SUPPORT
	default y
```

## boards/adi/adsp_sc83x/adsp_sc83x_adsp_sc834w_defconfig
```kconfig
#
# Copyright (c) 2023 Analog Devices
#
# SPDX-License-Identifier: Apache-2.0
#

# General Configuration
CONFIG_RUNTIME_NMI=y
CONFIG_ARM_MPU=y
CONFIG_ARM_TRUSTZONE_M=y
CONFIG_KERNEL_MEM_POOL=y
CONFIG_GEN_ISR_TABLES=y
CONFIG_BUILTIN_STACK_GUARD=y
CONFIG_EXTRA_EXCEPTION_INFO=y
CONFIG_INIT_ARCH_HW_AT_BOOT=y

CONFIG_CONSOLE=y
CONFIG_SEMIHOST=y
CONFIG_SEMIHOST_CONSOLE=y
CONFIG_BUILD_OUTPUT_HEX=y
```

## boards/adi/adsp_sc83x/board.yml
```yaml
# Copyright (c) 2024 Analog Devices, Inc.
# SPDX-License-Identifier: Apache-2.0

board:
  name: adsp_sc83x
  vendor: adi
  socs:
    - name: adsp_sc834
    - name: adsp_sc834w
    - name: adsp_sc835
    - name: adsp_sc835w
```

## drivers/ethernet/Kconfig.ad3306
```kconfig
# Copyright (c) 2024 Analog Devices, Inc.
# SPDX-License-Identifier: Apache-2.0

menuconfig ETH_AD3306
	bool "AD3306 10BASE-T1S MAC-PHY"
	default y
	depends on DT_HAS_ADI_AD3306_ENABLED
	select SPI
	help
	  The AD3306 is a 10BASE-T1S IEEE 802.3™-2022 compliant MAC-PHY
	  for 10Mbps Single-Pair Ethernet (SPE).

if ETH_AD3306

config ETH_AD3306_RX_THREAD_STACK_SIZE
	int "Stack size for a thread that processes AD3306 IRQ"
	default 1024
	help
	  Size of the stack used for internal thread which is ran to
	  process raised AD3306 IRQ.

config ETH_AD3306_RX_THREAD_PRIO
	int "Priority for internal incoming packet handler"
	default 2
	help
	  Priority level for internal thread which is ran for AD3306
	  IRQ processing.

config ETH_AD3306_TIMEOUT
	int "IP buffer timeout"
	default 100
	help
	  Timeout in milliseconds. Maximum amount of time
	  that the driver will wait from the IP stack to get
	  a memory buffer before the Ethernet frame is dropped.

endif # ETH_AD3306
```

## dts/bindings/ethernet/adi,ad3306.yaml
```yaml
# Copyright (c) 2024 Analog Devices Inc.
# SPDX-License-Identifier: Apache-2.0

description: |
  AD3306 10BASE-T1S Ethernet MAC-PHY with SPI Interface

  example:

  ad3306: ad3306@0 {
          compatible = "adi,ad3306";
          reg = <0x0>;
          spi-max-frequency = <DT_FREQ_M(25)>;
          int-gpios   = <&gpioc 1 (GPIO_ACTIVE_LOW | GPIO_PULL_UP)>;
          wake-gpios = <&gpioc 2 (GPIO_ACTIVE_HIGH | GPIO_PULL_DOWN)>;
          local-mac-address = [ 00 E0 22 FE DA D0 ];
          plca-enable;
          plca-node-id = <1>;
          plca-node-count = <8>;
          plca-max-burst-count = <0>;
          plca-burst-timer = <0x80>;
          plca-to-timer = <0x20>;
          status = "okay";
  };

compatible: "adi,ad3306"

include: [spi-device.yaml, ethernet-controller.yaml]

properties:
  int-gpios:
    type: phandle-array
    required: true
    description: |
      The interrupt (IRQn) pin of AD3306 is active low.
      If connected directly the MCU pin should be configured
      as active low.
  wake-gpios:
    type: phandle-array
    required: true
    description: |
      WAKE pin of AD3306 is used to trigger a wake-up of the
      local PHY and to optionally send a WUP over the network.
      By default, it is active high.
  plca-enable:
    type: boolean
    description: Enable/Disable PLCA.
  plca-node-id:
    type: int
    description: PLCA Node ID.
  plca-node-count:
    type: int
    description: PLCA Node Count.
  plca-max-burst-count:
    type: int
    description: PLCA Max Burst Count.
  plca-burst-timer:
    type: int
    description: PLCA Burst Timer Value.
  plca-to-timer:
    type: int
    description: PLCA TO Timer Value.
  tx-cut-through-en:
    type: boolean
    description: Transmit Cut-Through Enable.
  rx-cut-through-en:
    type: boolean
    description: Receive Cut-Through Enable.
```

## soc/adi/adspsc83x/Kconfig
```kconfig
# Copyright (c) 2023 Analog Devices Inc.
# SPDX-License-Identifier: Apache-2.0

config SOC_FAMILY_ADSPSC83X
	select ARM
	select CPU_CORTEX_M33
	select CPU_HAS_ARM_MPU
	select CPU_HAS_ARM_SAU
	select CPU_HAS_FPU
	select DYNAMIC_DIRECT_INTERRUPTS
	select DYNAMIC_INTERRUPTS
```

## soc/adi/adspsc83x/Kconfig.defconfig
```kconfig
#
# Copyright (c) 2023 Analog Devices, Inc.
#
# SPDX-License-Identifier: Apache-2.0

if SOC_FAMILY_ADSPSC83X

config SYS_CLOCK_HW_CYCLES_PER_SEC
	default 40000000

config ADI_ICE_1000
	bool
	default y

config ADI_ICE_2000
	bool
	default y

config ADI_DEBUG
	bool
	default y

config ADI_GPIO_HAS_PINT
	bool
	default y

config NUM_IRQS
	default 326

rsource "Kconfig.defconfig.adsp*"

endif # SOC_FAMILY_ADSPSC83X
```

## soc/adi/adspsc83x/Kconfig.defconfig.adsp_sc834
```kconfig
#
# Copyright 2023 Analog Devices, Inc.
#
# SPDX-License-Identifier: Apache-2.0

if SOC_ADSP_SC834

config SOC
	default "adsp_sc834"

endif
```

## soc/adi/adspsc83x/Kconfig.defconfig.adsp_sc834w
```kconfig
#
# Copyright (c) 2023 Analog Devices, Inc.
#
# SPDX-License-Identifier: Apache-2.0

if SOC_ADSP_SC834W

config SOC
	default "adsp_sc834w"

endif
```

## soc/adi/adspsc83x/Kconfig.defconfig.adsp_sc835
```kconfig
#
# Copyright (c) 2023 Analog Devices
#
# SPDX-License-Identifier: Apache-2.0

if SOC_ADSP_SC835

config SOC
	default "adsp_sc835"

endif
```

## soc/adi/adspsc83x/Kconfig.defconfig.adsp_sc835w
```kconfig
#
# Copyright (c) 2023 Analog Devices
#
# SPDX-License-Identifier: Apache-2.0

if SOC_ADSP_SC835W

config SOC
	default "adsp_sc835w"

endif
```

## soc/adi/adspsc83x/Kconfig.soc
```kconfig
#
# Copyright (c) 2023 Analog Devices Inc
#
# SPDX-License-Identifier: Apache-2.0

config SOC_FAMILY_ADSPSC83X
	bool

config SOC_FAMILY
	default "adspsc83x" if SOC_FAMILY_ADSPSC83X

config SOC_ADSP_SC834
	bool
	select SOC_FAMILY_ADSPSC83X

config SOC_ADSP_SC834W
	bool
	select SOC_FAMILY_ADSPSC83X

config SOC_ADSP_SC835
	bool
	select SOC_FAMILY_ADSPSC83X

config SOC_ADSP_SC835W
	bool
	select SOC_FAMILY_ADSPSC83X

config SOC
	default "adsp_sc834" if SOC_ADSP_SC834
	default "adsp_sc834w" if SOC_ADSP_SC834W
	default "adsp_sc835" if SOC_ADSP_SC835
	default "adsp_sc835w" if SOC_ADSP_SC835W
```
