/*
 * Copyright (c) 2023 Analog Devices, Inc.
 *
 * SPDX-License-Identifier: Apache-2.0
 *
 */

/dts-v1/;

#include <adi/adsp/adsp_sc83x-1MB.dtsi>

/{
	chosen {
		zephyr,sram = &l2_sram;
		zephyr,flash = &l1_iram;
	};
};
