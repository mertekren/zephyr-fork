/*
 * Copyright (c) 2023 Analog Devices, Inc.
 *
 * SPDX-License-Identifier: Apache-2.0
 */

&owm_io_p0_12 {
	power-source=<MAX32_VSEL_VDDIOH>;
};

&owm_pe_p0_13 {
	power-source=<MAX32_VSEL_VDDIOH>;
};

&w1 {
	status = "okay";
	pinctrl-0 = <&owm_io_p0_12 &owm_pe_p0_13>;
	pinctrl-names = "default";
	internal-pullup = <1>;
	external-pullup = <0>;
	long-line-mode = <0>;
};
